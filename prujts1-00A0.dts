/*
* Copyright (C) 2013 Matt Ranostay <mranostay@gmail.com>
*
* This program is free software; you can redistribute it and/or modify
* it under the terms of the GNU General Public License version 2 as
* published by the Free Software Foundation.
*/
/dts-v1/;
/plugin/;

/ {
	compatible = "ti,beaglebone", "ti,beaglebone-black";

	/* identification */
	part-number = "prujts";
	version = "00A0";

	/* state the resources this cape uses */

	fragment@0 {
		target = <&am33xx_pinmux>;
		__overlay__ {

			pru_pru_pins: pinmux_pru_pru_pins {
				pinctrl-single,pins = <
					0x190 0x05
				>;
			};
		};	
	};

	fragment@2 {
		target = <&pruss>;
		__overlay__ {
			status = "okay";

			pinctrl-names = "default";
			pinctrl-0 = <&pru_pru_pins>;
		};
	};
};
